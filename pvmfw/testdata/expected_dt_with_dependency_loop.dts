/dts-v1/;

// Note: We can't use label syntax here.
// Implementation applies overlay after removing /__symbols__,
// so using label syntax here wouldn't match with the actual reasult.

/include/ "platform_preprocessed.dts"

/ {
    node_c {
        phandle = <0x30>;
        loop_dep = <0x36>; // loop_dep = <&node_c_loop>;
        reg = <0x0 0xFF200 0x0 0x1>;
        interrupts = <0x0 0xF 0x4>;
        iommus;
    };

    node_c_loop {
        phandle = <0x36>;
        loop_dep = <0x30>; // loop_dep = <&node_c>;
    };

    /delete-node/ pviommu0;
    /delete-node/ pviommu1;
    /delete-node/ pviommu2;
    /delete-node/ pviommu3;
    /delete-node/ pviommu4;
    /delete-node/ pviommu5;
    /delete-node/ pviommu6;
    /delete-node/ pviommu7;
    /delete-node/ pviommu8;
    /delete-node/ pviommu9;
};