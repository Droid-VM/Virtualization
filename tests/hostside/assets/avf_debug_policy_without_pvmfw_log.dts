/dts-v1/;
/plugin/;

/ {
    fragment@avf {
        target-path = "/";

        __overlay__ {
            avf {
                pvmfw {
                    log = <0>;
                };
            };
        };
    };
};